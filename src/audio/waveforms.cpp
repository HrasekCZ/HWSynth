// Waveform implementations: PROGMEM sine table with interpolation, LCG noise, 5 generators.
#include "waveforms.h"

// ---------------------------------------------------------------------------
// Sine lookup table — 256 entries, stored in flash to save RAM
// ---------------------------------------------------------------------------
static const float SINE_TABLE[256] PROGMEM = {
     0.000000f,  0.024541f,  0.049068f,  0.073565f,  0.098017f,  0.122411f,  0.146730f,  0.170962f,
     0.195090f,  0.219101f,  0.242980f,  0.266713f,  0.290285f,  0.313682f,  0.336890f,  0.359895f,
     0.382683f,  0.405241f,  0.427555f,  0.449611f,  0.471397f,  0.492898f,  0.514103f,  0.534998f,
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    -0.195090f, -0.170962f, -0.146730f, -0.122411f, -0.098017f, -0.073565f, -0.049068f, -0.024541f,
};

// ---------------------------------------------------------------------------
// LCG — fast noise on ESP32, no stdlib dependency
// ---------------------------------------------------------------------------
static uint32_t noiseSeed = 22695477UL;

static inline float lcgNoise() {
    noiseSeed = noiseSeed * 1664525UL + 1013904223UL;
    // Map uint32 to -1.0 – 1.0
    return (float)(int32_t)noiseSeed / 2147483648.0f;
}

// ---------------------------------------------------------------------------

void initWaveforms() {
    noiseSeed = 22695477UL;
}

// ---------------------------------------------------------------------------
// Individual waveforms
// ---------------------------------------------------------------------------

float waveSine(float phase) {
    // Linear interpolation between two table entries
    float idx   = phase * 256.0f;
    uint8_t i   = (uint8_t)idx;
    float   frac = idx - (float)i;
    float   a   = pgm_read_float(&SINE_TABLE[i]);
    float   b   = pgm_read_float(&SINE_TABLE[(i + 1) & 0xFF]);
    return a + frac * (b - a);
}

float waveSquare(float phase) {
    return phase < 0.5f ? 1.0f : -1.0f;
}

float waveSaw(float phase) {
    // Rises from -1 to +1 over 0..1
    return 2.0f * phase - 1.0f;
}

float waveTriangle(float phase) {
    // Rises 0→1 in first half, falls 1→-1 in second half
    if (phase < 0.25f)
        return 4.0f * phase;
    else if (phase < 0.75f)
        return 2.0f - 4.0f * phase;
    else
        return 4.0f * phase - 4.0f;
}

float waveNoise() {
    return lcgNoise();
}

// ---------------------------------------------------------------------------

float getWaveformSample(uint8_t waveform, float phase) {
    switch (waveform) {
        case WAVE_SINE:     return waveSine(phase);
        case WAVE_SQUARE:   return waveSquare(phase);
        case WAVE_SAW:      return waveSaw(phase);
        case WAVE_TRIANGLE: return waveTriangle(phase);
        case WAVE_NOISE:    return waveNoise();
        default:            return 0.0f;
    }
}

float blendWaveforms(uint8_t waveformA, uint8_t waveformB, float phase, float blend) {
    float a = getWaveformSample(waveformA, phase);
    float b = getWaveformSample(waveformB, phase);
    return a + blend * (b - a);
}
